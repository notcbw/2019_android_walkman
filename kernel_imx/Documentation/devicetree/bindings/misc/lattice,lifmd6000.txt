## kernel_imx/Documentation/devicetree/bindings/misc/lattice,lifmd6000.txt
```
* DSD Remastering Engine's firmware file writer driver for ICX1295
  (Serial Peripheral Interface)

Required properties:
- compatible :
  - "lattice,lifmd6000" for DSD RME FW writer
- spi-max-frequency : Speed of spi communication
- reg : Offset and length of the register set for the device
- cs-gpios : Specifies the gpio pins to be used for chipselects.
- en-gpios : Specifies the gpio pins to be used for RME power.
- wkup-gpios : Specifies the gpio pins to be used for RME wakeup.
- rst-gpios : Specifies the gpio pins to be used for RME reset.

Example:
	rme_write: rme_write@2 {
		compatible = "lattice,lifmd6000";
		spi-max-frequency = <20000000>;
		reg = <2>;
		cs-gpio = <&gpio5 9 GPIO_ACTIVE_HIGH>;
		en-gpio = <&gpio1 12 GPIO_ACTIVE_HIGH>;
		wkup-gpio = <&gpio1 11 GPIO_ACTIVE_HIGH>;
		rst-gpio = <&gpio1 26 GPIO_ACTIVE_HIGH>;
	};
};
```

## kernel_imx/Documentation/devicetree/bindings/misc/sony,gps_ctl.txt
```
GPS pin control on gpio

Required properties:
- compatible: "sony,gps_ctl"
- xrst-gpios: one gpio-specifier for "gps_xrst"
- boot-gpios: one gpio-specifier for "gps_boot_rec"
  You can omit gpio of unused pins
- reset_time_us: Reset pulse length, microsecond unit

Example:

	gps_ctl {
		compatible = "sony,gps_ctl";
		xrst-gpios = <&gpio3 14 GPIO_ACTIVE_LOW>;
		boot-gpios = <&gpio3 9 GPIO_ACTIVE_HIGH>;
		reset_time_us = <100000>;
	};
```

## kernel_imx/Documentation/devicetree/bindings/misc/sony,hold_switch.txt
```
Device-Tree bindings for misc/hold_switch.c driver

Required properties:
	- compatible = "sony,hold_switch";
	- hold-gpios: A spec of gpio to detect switch state.

Optional properties:
	- debounce-interval: Debouncing interval time in milliseconds.
	  If not specified default to 10.

Example:

	hold_switch {
		compatible = "sony,hold_switch";
		hold-gpios = <&gpio1 0 GPIO_ACTIVE_HIGH>;
		debounce-interval = <15>;
	};
```

## kernel_imx/drivers/input/misc/bma422/Kconfig
```kconfig
#
# Makefile for Bosch sensors driver.
#
config BOSCH_DRIVER_LOG_FUNC
	tristate "Bosch Sensortec driver smart log function support"
	depends on (I2C || SPI_MASTER) && SYSFS
	help
	 If you say yes here, you get support for smart log function in Bosch Sensortec driver.

config SENSORS_BMA4XY
	tristate "BMA4XY Sensor Support"
	depends on I2C || SPI_MASTER
	help
	 If you say yes here, you get support for Bosch Sensortec's sensor driver of BMA4XY.

config BMA4XY_MAG_INTERFACE_SUPPORT
	tristate "BMA4XY Sensor mag interface support"
	depends on SENSORS_BMA4XY
	help
	 If you say yes here, you get support for Bosch Sensortec's
	 sensor driver of BMA4XY with mag sensor support.
```

## kernel_imx/drivers/misc/exclusive_rme_tp/Kconfig
```kconfig
#
# Exclusive Module of RME FW write driver & Touch Panel driver configuration
#

config EXCLUSIVE_RME_TP
	bool "exclusive rme and tp module"
	help
	  exclusive rme and tp module.
```

## kernel_imx/drivers/misc/gps_ctl/Kconfig
```kconfig
menu "GPS Pin control support"

config GPS_PIN_CTRL
	tristate "gps pin control"
	default n
	help
	  enable gps pin control

endmenu
```

## kernel_imx/drivers/misc/icx_dmp/Kconfig
```kconfig
#
# Kconfig to configure ICX DMP board common drivers
#
# Copyright 2018 Sony Video & Sound Products Inc.
#
# This program is free software; you can redistribute it and/or modify
# it under the terms of the GNU General Public License as published by
# the Free Software Foundation; either version 2 of the License, or
# (at your option) any later version.
#
# This program is distributed in the hope that it will be useful,
# but WITHOUT ANY WARRANTY; without even the implied warranty of
# MERCHANTABILITY or FITNESS FOR A PARTICULAR PURPOSE.  See the
# GNU General Public License for more details.

menu "SVS ICX DMP board drivers"
config ICX_DMP_BOARD_ID
	bool "ICX DMP model board ID reader"
	select OF
	select PINCTRL
	select GPIOLIB
	help
	  Provides ICX DMP model board configuration information
	  to other kernel drivers and Userland applications.

endmenu
```

## kernel_imx/drivers/misc/lifmd6000/Kconfig
```kconfig
#
# LIF-MD6000 RME FW write driver configuration
#

config LIFMD6000_RME_FW_WRITE
	tristate "LIF-MD6000 RME FW write driver"
	select SPI
	help
	  LIFMD6000 RME FW write driver.
```

## kernel_imx/drivers/usb/chipidea/Kconfig
```kconfig
config USB_CHIPIDEA
	tristate "ChipIdea Highspeed Dual Role Controller"
	depends on ((USB_EHCI_HCD && USB_GADGET) || (USB_EHCI_HCD && !USB_GADGET) || (!USB_EHCI_HCD && USB_GADGET)) && HAS_DMA
	select EXTCON
	select RESET_CONTROLLER
	help
	  Say Y here if your system has a dual role high speed USB
	  controller based on ChipIdea silicon IP. It supports:
	  Dual-role switch (ID, OTG FSM, sysfs), Host-only, and
	  Peripheral-only.

	  When compiled dynamically, the module will be called ci-hdrc.ko.

if USB_CHIPIDEA

config USB_CHIPIDEA_OF
	tristate
	depends on OF
	default USB_CHIPIDEA

config USB_CHIPIDEA_PCI
	tristate
	depends on USB_PCI
	depends on NOP_USB_XCEIV
	default USB_CHIPIDEA

config USB_CHIPIDEA_UDC
	bool "ChipIdea device controller"
	depends on USB_GADGET
	help
	  Say Y here to enable device controller functionality of the
	  ChipIdea driver.

config USB_CHIPIDEA_CHAGER_DETECT_EXTCON
	bool "Enable extcon class driver to notify detected charger"
	depends on USB_CHIPIDEA_UDC
	help
	  Say Y here to enable extcon class driver to notify detected
	  USB AC charger. Currently supports SDP, CDP and DCP.

	  Say N here to disable extcon class driver. And keep NXP's
	  charger detection handling.

config USB_CHIPIDEA_HOST
	bool "ChipIdea host controller"
	depends on USB_EHCI_HCD
	select USB_EHCI_ROOT_HUB_TT
	help
	  Say Y here to enable host controller functionality of the
	  ChipIdea driver.

config USB_CHIPIDEA_ULPI
	bool "ChipIdea ULPI PHY support"
	depends on USB_ULPI_BUS=y || USB_ULPI_BUS=USB_CHIPIDEA
	help
	  Say Y here if you have a ULPI PHY attached to your ChipIdea
	  controller.

config USB_ICX_VBUS_SUSPEND_OFF
	bool "Off VBUS output while suspending"
	depends on USB_CHIPIDEA_HOST
	help
	  Say Y here to enable "off VBUS output while suspending" feature.
	  The device tree property "shes,vbus-suspend-off" controls VBUS
	  output while suspending.
	  Say N here to disable "off VBUS output while suspending" feature.

endif
```
